#include <SPI.h>
#include "RF24.h"
#include <Wire.h>
#include <GOFi2cOLED.h>
#include <avr/pgmspace.h>
int ledPin = 4;
GOFi2cOLED GOFoled;

/* Địa chỉ của DS1307 */
const byte DS1307 = 0x68;
/* Số byte dữ liệu sẽ đọc từ DS1307 */
const byte NumberOfFields = 7;
 
/* khai báo các biến thời gian */
int second, minute, hour, day, wday, month, year;
 
//32x32 pixeles
const unsigned char PROGMEM heart1[]={
0x00, 0x00, 0x00, 0x00, 0xC0, 0xE0, 0xE0, 0xF0, 0xF0, 0xF0, 0xF0, 0xF0, 0xF0, 0xE0, 0xC0, 0x80,
0x80, 0xC0, 0xE0, 0xF0, 0xF0, 0xF0, 0xF0, 0xF0, 0xF0, 0xF0, 0xE0, 0xC0, 0x80, 0x00, 0x00, 0x00,
0x00, 0x00, 0x00, 0x7F, 0xFF, 0xFF, 0xFF, 0xFF, 0xFF, 0xFF, 0xFF, 0xFF, 0xFF, 0xFF, 0xFF, 0xFF,
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0x0F, 0x07, 0x03, 0x03, 0x01, 0x00, 0x00, 0x00, 0x00, 0x00, 0x00, 0x00, 0x00, 0x00, 0x00, 0x00
};

//56x56 pixeles
const unsigned char PROGMEM heart2[]={
0x00, 0x00, 0x00, 0x00, 0x00, 0x00, 0x80, 0x80, 0xC0, 0xE0, 0xE0, 0xE0, 0xF0, 0xF0, 0xF0, 0xF0,
0xF0, 0xF0, 0xE0, 0xE0, 0xE0, 0xC0, 0x80, 0x80, 0x00, 0x00, 0x00, 0x00, 0x00, 0x00, 0x00, 0x00,
0x80, 0x80, 0xE0, 0xE0, 0xE0, 0xE0, 0xF0, 0xF0, 0xF0, 0xF0, 0xF0, 0xE0, 0xE0, 0xE0, 0xE0, 0xC0,
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0x00, 0x00, 0x00, 0x00, 0x00, 0x00, 0x00, 0x00, 
};

const uint64_t pipe = 0xE8E8F0F0E1LL; // địa chỉ phát
//const uint64_t pipe = 0x1; // địa chỉ phát
RF24 radio(9,10);//thay 10 thành 53 với mega
//byte msg;
const int led = 3;
int led_st = 0;
 
void setup(){
  Serial.begin(9600);
  radio.begin();                     
  radio.setAutoAck(1);              
  radio.setDataRate(RF24_1MBPS);    // Tốc độ dữ liệu
  radio.setChannel(10);               // Đặt kênh
  radio.openReadingPipe(1,pipe);     
  radio.startListening();            
  pinMode(7, OUTPUT);

   GOFoled.init(0x3C);
  // init done
  
  GOFoled.display(); // show splashscreen
  delay(2000);
  GOFoled.clearDisplay();

  GOFoled.setTextSize(1);
  GOFoled.setTextColor(WHITE);

 Wire.begin();
  /* cài đặt thời gian cho module */
  setTime(12, 30, 45, 1, 8, 2, 15); // 12:30:45 CN 08-02-2015
  Serial.begin(9600);
  pinMode(ledPin, OUTPUT);
   pinMode(3, INPUT_PULLUP); // sử dụng điện trở kéo lên cho chân số 2, ngắt 0
   attachInterrupt(1, tatled, FALLING); // gọi hàm tatled liên tục khi còn nhấn nút
  
}

void tatled()
{
    digitalWrite(ledPin, HIGH); // tắt đèn led
    delay(500);
}
 
void loop()
{
//   GOFoled.setCursor(20,56);
//  GOFoled.print("www.arduino.vn"); 
//  GOFoled.drawBitmap(48, 16, heart1, 32, 32, WHITE);  //draw heart1 bitmap.
//  GOFoled.display();
//  delay(500);  
//  GOFoled.clearDisplay();
//  
//  GOFoled.setCursor(20,56);
//  //GOFoled.print("www.arduino.vn");   
//  //GOFoled.drawBitmap(36, 2, heart2, 56, 56, WHITE);  //draw heart2 bitmap.
//  GOFoled.drawChar(10,10,'6',WHITE,BLACK,5);
//  //GOFoled.print("www.arduino.vn");
//  GOFoled.display();
//  delay(500);  
//  GOFoled.clearDisplay();  
//  
  byte msg;
  digitalWrite(7,LOW);
  if (radio.available()){
    while (radio.available()){
      radio.read(&msg, sizeof(msg));
      Serial.println(msg);
      if(msg == 10)
      digitalWrite(7,HIGH);
      delay(50);
    }
  }

//    /* Đọc dữ liệu của DS1307 */
//  readDS1307();
//  /* Hiển thị thời gian ra Serial monitor */
//  digitalClockDisplay();
//  //Serial.print(second);
//  delay(1000);
  digitalWrite(ledPin, LOW);   // bật đèn led
}

void readDS1307()
{
        Wire.beginTransmission(DS1307);
        Wire.write((byte)0x00);
        Wire.endTransmission();
        Wire.requestFrom(DS1307, NumberOfFields);
        
        second = bcd2dec(Wire.read() & 0x7f);
        minute = bcd2dec(Wire.read() );
        hour   = bcd2dec(Wire.read() & 0x3f); // chế độ 24h.
        wday   = bcd2dec(Wire.read() );
        day    = bcd2dec(Wire.read() );
        month  = bcd2dec(Wire.read() );
        year   = bcd2dec(Wire.read() );
        year += 2000;    
}
/* Chuyển từ format BCD (Binary-Coded Decimal) sang Decimal */
int bcd2dec(byte num)
{
        return ((num/16 * 10) + (num % 16));
}
/* Chuyển từ Decimal sang BCD */
int dec2bcd(byte num)
{
        return ((num/10 * 16) + (num % 10));
}
 
void digitalClockDisplay(){
    // digital clock display of the time
    Serial.print(hour);
    printDigits(minute);
    printDigits(second);
    Serial.print(" ");
    Serial.print(day);
    Serial.print(" ");
    Serial.print(month);
    Serial.print(" ");
    Serial.print(year); 
    Serial.println(); 
}
 
void printDigits(int digits){
    // các thành phần thời gian được ngăn chách bằng dấu :
    Serial.print(":");
        
    if(digits < 10)
        Serial.print('0');
    Serial.print(digits);
}
 
/* cài đặt thời gian cho DS1307 */
void setTime(byte hr, byte min, byte sec, byte wd, byte d, byte mth, byte yr)
{
        Wire.beginTransmission(DS1307);
        Wire.write(byte(0x00)); // đặt lại pointer
        Wire.write(dec2bcd(sec));
        Wire.write(dec2bcd(min));
        Wire.write(dec2bcd(hr));
        Wire.write(dec2bcd(wd)); // day of week: Sunday = 1, Saturday = 7
        Wire.write(dec2bcd(d)); 
        Wire.write(dec2bcd(mth));
        Wire.write(dec2bcd(yr));
        Wire.endTransmission();
}
